## drivers/platform/msm/Kconfig
```kconfig
# SPDX-License-Identifier: GPL-2.0-only
#
# MSM Platform Specific Drivers
#

menuconfig MSM_PLATFORM_DEVICES
	bool "MSM Platform Specific Device Drivers"
        depends on ARCH_QCOM
	default y
	help
	  Say Y here to get to see options for device drivers of various
	  MSM platforms, including vendor-specific netbook/laptop/desktop
	  extension and hardware monitor drivers. This option itself does
	  not add any kernel code.

	  If you say N, all options in this submenu will be skipped and disabled.


if MSM_PLATFORM_DEVICES

config QPNP_REVID
        tristate "QPNP Revision ID Peripheral"
        depends on SPMI
        default y
        help
          Say 'y' here to include support for the Qualcomm Technologies, Inc.
          QPNP REVID peripheral. REVID prints out the PMIC type and revision
          numbers in the kernel log along with the PMIC option status. The PMIC
          type is mapped to a QTI chip part number and logged as well.

endif # MSM_PLATFORM_DEVICES
```

## drivers/power/supply/qcom/Kconfig
```kconfig
menu "Qualcomm Technologies, Inc. Charger and Fuel Gauge support"

config QPNP_FG_GEN4
        tristate "QPNP GEN4 fuel gauge driver"
        depends on QPNP_SMB5_NABU
        help
          Say Y here to enable the GEN4 Fuel Gauge driver. This adds support
          for battery fuel gauging and state of charge of battery connected to
          the device that has QTI PMICs like PM8150B. The state of charge is
          reported through a BMS power supply property and also sends uevents
          when the capacity is updated.

config QPNP_SMB5_NABU
        tristate "SMB5 Battery Charger"
        depends on MFD_SPMI_PMIC
        help
          Say Y to enables support for the SMB5 charging peripheral.
          The QPNP SMB5 charger driver supports the charger peripheral
          present in the chip.
          The power supply framework is used to communicate battery and
          usb properties to userspace and other driver consumers such
          as fuel gauge, USB, and USB-PD.
          VBUS and VCONN regulators are registered for supporting OTG,
          and powered Type-C cables respectively.

endmenu
```
